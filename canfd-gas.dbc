VERSION ""

NS_ :

BS_:

BU_: XXX

BO_ 181 GAS?: 32 XXX
 SG_ NEW_SIGNAL_1 : 64|8@1+ (1,0) [0|255] "" XXX
